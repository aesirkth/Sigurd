## zephyr-firmware/sigurd/boards/vendor/sigurd/board.yml
```yaml
board:
  name: sigurd
  full_name: sigurd propulsion sensor unit
  vendor: aesir
  socs:
    - name: stm32u575xx
```

## zephyr-firmware/sigurd/modules/ad4111/Kconfig
```kconfig
config AD4111
	bool "AD4111 ADC"
	default y
	depends on DT_HAS_ANALOG_AD4111_ENABLED
	select SPI
	help
		Enable AD4111 ADC driver.
```
