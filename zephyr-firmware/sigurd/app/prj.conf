## CMakeLists.txt
```
#-------------------------------------------------------------------------------
# Zephyr Example Application
#
# Copyright (c) 2021 Nordic Semiconductor ASA
# SPDX-License-Identifier: Apache-2.0

cmake_minimum_required(VERSION 3.13.1)


list(APPEND ZEPHYR_EXTRA_MODULES
    ${CMAKE_CURRENT_SOURCE_DIR}/modules/ad4111
)

find_package(Zephyr REQUIRED HINTS $ENV{ZEPHYR_BASE})


project(app LANGUAGES C)

target_sources(app PRIVATE src/main.c  src/can_com.c src/ad4111.c src/sensors.c)
```

## sample.yaml
```
# This file is provided so that the application can be compiled using Twister,
# the Zephyr testing tool. In this file, multiple combinations can be specified,
# so that you can easily test all of them locally or in CI.
sample:
  description: Sigurd - Propulsion sensor unit
  name: sigurd 
common:
  build_only: false
tests:
  app.default: {}
  app.debug:
    extra_overlay_confs:
      - debug.conf

      
```

## prj.conf
```kconfig
# Copyright (c) 2021 Nordic Semiconductor ASA
# SPDX-License-Identifier: Apache-2.0
#
# This file contains selected Kconfig options for the application.

#CONFIG_SENSOR=y
#CONFIG_BLINK=y
CONFIG_GPIO=y
CONFIG_PWM=y
CONFIG_CAN=y
CONFIG_CAN_FD_MODE=y #TODO: not sure do we need this?
CONFIG_AD4111=y
```

## src/main.c
```c
/*
 * Copyright (c) 2016 Intel Corporation
 *
 * SPDX-License-Identifier: Apache-2.0
 */

#include <stdio.h>
#include <zephyr/kernel.h>
#include <zephyr/logging/log.h>
#include <zephyr/drivers/gpio.h>
#include <zephyr/device.h>
#include <zephyr/devicetree.h>
#include <zephyr/kernel.h>
#include <zephyr/drivers/pinctrl.h>
// #include <zephyr/dt-bindings/pinctrl/stm32-pinctrl.h>

#include "main.h"
#include "sensors.h"
#include "can_com.h"
// #include "spitest.h"
#include "ad4111.h"

LOG_MODULE_REGISTER(main, LOG_LEVEL_DBG);

static const struct gpio_dt_spec tx_led = GPIO_DT_SPEC_GET(DT_NODELABEL(led0), gpios);
//static const struct gpio_dt_spec rx_led = GPIO_DT_SPEC_GET(DT_NODELABEL(led1), gpios);
static const struct gpio_dt_spec g_led = GPIO_DT_SPEC_GET(DT_NODELABEL(g), gpios);
static const struct gpio_dt_spec r_led = GPIO_DT_SPEC_GET(DT_NODELABEL(r), gpios);
static const struct gpio_dt_spec chipselect = GPIO_DT_SPEC_GET(DT_NODELABEL(chipselect1), gpios);

/*
static const struct gpio_dt_spec miso_spec = GPIO_DT_SPEC_GET(DT_NODELABEL(spiadcready), gpios);


static struct gpio_callback miso_cb_data;
*/

//according to ad4111 faq, and datasheet this is the following way to configure:
//reset
//check ID
//configure ADC mode (not sure before or after which config) - I have not written a function for this!
//first configure channel (check channel registers on datasheet)
//then configure setup
//then configure filter
//done

//ad4111.h, a new header file i wrote contains helpful enums and structs

/*
int spi_adc_int_count = 0;

void miso_interrupt_handler(const struct device *dev, struct gpio_callback *cb,
		    uint32_t pins) {
	spi_adc_int_count++;
}
*/

bool test_led_flag = false;

const struct can_filter test_filter = {
    .flags = 0,
    .id = 0x122,
    .mask = 0b11111111111 
};

void can_rx_cb(const struct device *const device, struct can_frame *frame, void *user_data) {
	// do something in here.
	// but dont use k_msleep!

	if (frame->dlc != 1) {
        LOG_ERR("received packet with id %d has length %d. Sigurd expects all packets to have size 1.", frame->id, frame->dlc);
    }

	test_led_flag = true;

}

int initialize_pins(void) { 
	int ret;

	if (!gpio_is_ready_dt(&g_led)) LOG_ERR("LED NOT READY");

	ret = gpio_pin_configure_dt(&g_led, GPIO_OUTPUT_ACTIVE);
	ret = gpio_pin_configure_dt(&tx_led, GPIO_OUTPUT_ACTIVE);

	ret = gpio_pin_configure_dt(&chipselect, GPIO_OUTPUT_INACTIVE); // TODO: Move this ad4111.c
	gpio_pin_set_dt(&chipselect, 1);

	if (ret < 0) LOG_ERR("FAILED TO CONFIGURE LED");

	if (!gpio_is_ready_dt(&r_led)) LOG_ERR("LED NOT READY");

	gpio_pin_toggle_dt(&g_led);
	ret = gpio_pin_configure_dt(&r_led, GPIO_OUTPUT_ACTIVE);
	if (ret < 0) LOG_ERR("FAILED TO CONFIGURE LED");
	gpio_pin_toggle_dt(&g_led);
	return ret;
}

void flash_led(void) { 
	gpio_pin_toggle_dt(&g_led);
	k_msleep(400);
	gpio_pin_toggle_dt(&g_led);
	k_msleep(300);
	gpio_pin_toggle_dt(&g_led);
	k_msleep(200);
	gpio_pin_toggle_dt(&g_led);
	k_msleep(100);
}

void error_sequence_led(void) { 
	for (int i = 0; i < 50; i++) {
		gpio_pin_toggle_dt(&r_led);
		k_msleep(100);
	}
}

// Convert an arry of floats into a packed array of 2 bytes
void floats_to_bytes(uint8_t *bytes, float *floats, int n, float factor) {
	for (int i = 0; i < n; i++) {
		uint16_t value = factor * floats[i];
		// uint16_t value = floats[i]*10000-545;
		bytes[2*i] = (value >> 8 & 0xFF);
		bytes[2*i+1] = (value & 0xFF);
	}
}

void floats_to_degrees(uint8_t *bytes, float *floats, int n) {
	for (int i = 0; i < n; i++) {
		// uint16_t value = factor * floats[i];
		// uint16_t value = floats[i]*10000-545;
		uint16_t value = floats[i]*10000-545;
		bytes[2*i] = (value >> 8 & 0xFF);
		bytes[2*i+1] = (value & 0xFF);
	}
}

int main(void) {

	int ret;
	ret = initialize_pins();
	if (ret != 0) {
		LOG_ERR("FAILED TO CONFIGURE PINS");
		error_sequence_led();
		return 0;
	}
	// ret = initialize_interrupt();
	// if (ret != 0) {
	// 	LOG_ERR("FAILED TO CONFIGURE INTERRUPT");
	// 	return 0;
	// }
	
	// runsetupspi();
	flash_led();

	// ret = ad4111_init();
	// if (ret !=0) {
	// 	error_sequence_led();
	// 	return 0;
	// }

	init_can();
	// uint8_t batch_data[20]; // data from a full batch of all channels, scaled to nV
	// int16_t channel_readout_stat = 0; // is 0000001111111111 when all 10 channels are read out

	// struct running_average adc_running_averages[10];

	init_sensors();
	float V_TO_mV_factor = 1000, A_TO_uA_factor = 1000000;
	while(true) {
		k_msleep(1000);
		// Thermalcouples CAN message
		float thermocouple_voltages[4];
		uint8_t thermocouple_bytes[8];
		ret = thermocouple_get_voltages(thermocouple_voltages);
		if(ret < 0) {
			error_sequence_led();
			continue;
		}
		floats_to_bytes(thermocouple_bytes, thermocouple_voltages, 4, V_TO_mV_factor);
		// submit_can_pkt(0x120, thermocouple_bytes, 8);

		// Pressure guages CAN message
		float pressure_gauges_currents[4];
		uint8_t pressure_guages_bytes[8];
		ret = pressure_gauges_get_currents(pressure_gauges_currents);
		if(ret < 0) {
			error_sequence_led();
			continue;
		}
		floats_to_bytes(pressure_guages_bytes, pressure_gauges_currents, 4, A_TO_uA_factor);
		// submit_can_pkt(0x121, pressure_guages_bytes, 8);

		// RTDs CAN message
		float rtd_voltages[2];
		uint8_t rtd_bytes[4];
		ret = rtds_get_voltages(rtd_voltages);
		if(ret < 0) {
			error_sequence_led();
			continue;
		}
		floats_to_degrees(rtd_bytes, rtd_voltages, 2);
		submit_can_pkt(0x122, rtd_bytes, 4);
	}
	
	return 0;
}
```

## src/ad4111.c
```c
#include "can_com.h"
#include <zephyr/kernel.h>
#include <zephyr/drivers/spi.h>
#include <zephyr/logging/log.h>
#include <assert.h>

LOG_MODULE_REGISTER(ADC_AD4111, LOG_LEVEL_DBG);

#define AD4111_CMD_READ       0x40
#define AD4111_CMD_WRITE      0x0

typedef enum {
	AD4111_STATUS_REG = 0x00,
	AD4111_MODE_REG = 0x01,
	AD4111_IFMODE_REG = 0x02,
	AD4111_REGCHECK = 0x03,
	AD4111_DATA_REG = 0x04,
	AD4111_GPIOCON_REG = 0x06,
	AD4111_ID_REG = 0x07,
	AD4111_CHANNEL_0_REG = 0x10,
	AD4111_CHANNEL_1_REG = 0x11,
	AD4111_CHANNEL_2_REG = 0x12,
	AD4111_CHANNEL_3_REG = 0x13,
	AD4111_CHANNEL_4_REG = 0x14,
	AD4111_CHANNEL_5_REG = 0x15,
	AD4111_CHANNEL_6_REG = 0x16,
	AD4111_CHANNEL_7_REG = 0x17,
	AD4111_CHANNEL_8_REG = 0x18,
	AD4111_CHANNEL_9_REG = 0x19,
	AD4111_CHANNEL_10_REG = 0x1A,
	AD4111_CHANNEL_11_REG = 0x1B,
	AD4111_CHANNEL_12_REG = 0x1C,
	AD4111_CHANNEL_13_REG = 0x1D,
	AD4111_CHANNEL_14_REG = 0x1E,
	AD4111_CHANNEL_15_REG = 0x1F,
	AD4111_SETUPCON0_REG = 0x20,
	AD4111_SETUPCON1_REG = 0x21,
	AD4111_SETUPCON2_REG = 0x22,
	AD4111_SETUPCON3_REG = 0x23,
	AD4111_SETUPCON4_REG = 0x24,
	AD4111_SETUPCON5_REG = 0x25,
	AD4111_SETUPCON6_REG = 0x26,
	AD4111_SETUPCON7_REG = 0x27,
	AD4111_FILTCON0_REG = 0x28,
	AD4111_FILTCON1_REG = 0x29,
	AD4111_FILTCON2_REG = 0x2A,
	AD4111_FILTCON3_REG = 0x2B,
	AD4111_FILTCON4_REG = 0x2C,
	AD4111_FILTCON5_REG = 0x2D,
	AD4111_FILTCON6_REG = 0x2E,
	AD4111_FILTCON7_REG = 0x2F,
	AD4111_OFFSET0_REG = 0x30,
	AD4111_OFFSET1_REG = 0x31,
	AD4111_OFFSET2_REG = 0x32,
	AD4111_OFFSET3_REG = 0x33,
	AD4111_OFFSET4_REG = 0x34,
	AD4111_OFFSET5_REG = 0x35,
	AD4111_OFFSET6_REG = 0x36,
	AD4111_OFFSET7_REG = 0x37,
	AD4111_GAIN0_REG = 0x38,
	AD4111_GAIN1_REG = 0x39,
	AD4111_GAIN2_REG = 0x3A,
	AD4111_GAIN3_REG = 0x3B,
	AD4111_GAIN4_REG = 0x3C,
	AD4111_GAIN5_REG = 0x3D,
	AD4111_GAIN6_REG = 0x3E,
	AD4111_GAIN7_REG = 0x3F,
} ad4111_reg_t;

typedef enum  {
    VIN0_VIN1 = 0x1,
    VIN0_VINCOM = 0x10,
    VIN1_VIN0 = 0x20,
    VIN1_VINCOM = 0x30,
    VIN2_VIN3 = 0x43,
    VIN2_VINCOM = 0x50,
    VIN3_VIN2 = 0x62,
    VIN3_VINCOM = 0x70,
    VIN4_VIN5 = 0x85,
    VIN4_VINCOM = 0x90,
    VIN5_VIN4 = 0xA4,
    VIN5_VINCOM = 0xB0,
    VIN6_VIN7 = 0xC7,
    VIN6_VINCOM = 0xD0,
    VIN7_VIN6 = 0xE6,
    VIN7_VINCOM = 0xF0,
    IIN3P_IIN3M = 0x18B,
    IIN2P_IIN2M = 0x1AA,
    IIN1P_IIN1M = 0x1C9,
    IIN0P_IIN0M = 0x1E8,
    TEMPERATURE_SENSOR = 0x232,
    REFERENCE = 0x2B6
} ad4111_input_t;

typedef enum {
    EXTERNAL_REF = 0x0,
    INTERNAL_REF = 0x2,
    AVDD_AVSS    = 0x3
} ad4111_ref_t;

typedef enum { 
    UNIPOLAR = 0x0,
    BIPOLAR  = 0x1
} ad4111_biunipolar_t;

typedef enum {
    AD4111_INBUF_DISABLED = 0x0,
    AD4111_INBUF_RSVD1    = 0x1,
    AD4111_INBUF_RSVD2    = 0x2,
    AD4111_INBUF_ENABLED  = 0x3
} ad4111_inbuf_t;


//doublecheck if these hex values are correct and align with the datasheet!
typedef enum {
    AD4111_ENHFILT_DISABLED = 0x0,
    AD4111_ENHFILT_ENABLED  = 0x1
} ad4111_enhfilten_t;

typedef enum {
    AD4111_ENHFILT_27SPS_47DB = 0x2,
    AD4111_ENHFILT_25SPS_62DB = 0x3,
    AD4111_ENHFILT_20SPS_86DB = 0x5,
    AD4111_ENHFILT_16SPS_92DB = 0x6
} ad4111_enhfilt_t;

typedef enum {
    AD4111_FILTER_SINC5_SINC1 = 0x0,
    AD4111_FILTER_SINC3       = 0x3
} ad4111_filter_order_t;

typedef enum {
    AD4111_ODR_31250_SPS   = 0x00,
    AD4111_ODR_15625_SPS   = 0x06,
    AD4111_ODR_10417_SPS   = 0x07,
    AD4111_ODR_5208_SPS    = 0x08,
    AD4111_ODR_2597_SPS    = 0x09,
    AD4111_ODR_1007_SPS    = 0x0A,
    AD4111_ODR_503_SPS     = 0x0B,
    AD4111_ODR_381_SPS     = 0x0C,
    AD4111_ODR_200_SPS     = 0x0D,
    AD4111_ODR_100_SPS     = 0x0E,
    AD4111_ODR_59_SPS      = 0x0F,
    AD4111_ODR_49_SPS      = 0x10,
    AD4111_ODR_20_SPS      = 0x11,
    AD4111_ODR_16_SPS      = 0x12,
    AD4111_ODR_10_SPS      = 0x13,
    AD4111_ODR_5_SPS       = 0x14,
    AD4111_ODR_2_5_SPS     = 0x15,
    AD4111_ODR_1_25_SPS    = 0x16
} ad4111_odr_t;

typedef struct {
	ad4111_reg_t reg;
	uint8_t ch_en;
	uint8_t setup_sel;
	ad4111_input_t input;
} ad4111_channel_t;

typedef struct { 
	ad4111_reg_t reg;
	ad4111_biunipolar_t bi_unipolar;
	uint8_t refbuf_plus;
	uint8_t refbuf_minus;
	ad4111_inbuf_t inbuf;
	ad4111_ref_t ref_sel;
} ad4111_setupcon_t;

#define AD4111_ADCMODE_REF_EN 15
#define AD4111_IFMODE_DATA_STAT 6

typedef struct {
	ad4111_reg_t reg;
	ad4111_enhfilten_t enhfilten;
	ad4111_enhfilt_t enhfilt;
	ad4111_filter_order_t order;
	ad4111_odr_t odr;
} ad4111_filter_t;

#define SPIOP SPI_WORD_SET(8) | SPI_TRANSFER_MSB | SPI_MODE_CPOL | SPI_MODE_CPHA 

struct spi_dt_spec spi = SPI_DT_SPEC_GET(DT_NODELABEL(ext_adc1), SPIOP);


// volatile int spi_adc_int_count = 0;
K_SEM_DEFINE(adc_data_ready, 0, 1);
void miso_interrupt_handler(const struct device *dev, struct gpio_callback *cb,
							uint32_t pins) {
	k_sem_give(&adc_data_ready);
}

volatile int ad4111_status = 0;

struct adc_result {
    uint8_t data[3];
    uint8_t status;
};

K_MSGQ_DEFINE(adc_results, sizeof(struct adc_result), 30, 1);

static const struct gpio_dt_spec miso_spec = GPIO_DT_SPEC_GET(DT_NODELABEL(spiadcready), gpios);
static struct gpio_callback miso_cb_data;

static int ad4111_read_reg(ad4111_reg_t reg_addr, uint8_t *buffer,
			   size_t reg_size) {
	int ret;

	uint8_t buffer_tx[6] = {0};
	uint8_t buffer_rx[ARRAY_SIZE(buffer_tx)] = {0xFF};
	const struct spi_buf tx_buf[] = {{
		.buf = buffer_tx,
		.len = ARRAY_SIZE(buffer_tx),
	}};
	const struct spi_buf rx_buf[] = {{
		.buf = buffer_rx,
		.len = ARRAY_SIZE(buffer_rx),
	}};
	const struct spi_buf_set tx = {
		.buffers = tx_buf,
		.count = ARRAY_SIZE(tx_buf),
	};
	const struct spi_buf_set rx = {
		.buffers = rx_buf,
		.count = ARRAY_SIZE(rx_buf),
	};
	buffer_tx[0] = AD4111_CMD_READ | reg_addr;

	ret = spi_transceive_dt(&spi, &tx, &rx);
	if (ret != 0) {
		LOG_ERR("error reading register 0x%X (%d)", reg_addr, ret);
		return ret;
	}

	// TODO: Check whether this can be avoided by use of sets.
	/* Copy received data in output buffer */
	for (uint8_t index = 0; index < reg_size; index++) {
		buffer[index] = buffer_rx[index + 1];
	}

	return ret;
}

static int ad4111_write_reg(ad4111_reg_t reg_addr, uint8_t *buffer, size_t reg_size) {
	int ret;
	uint8_t buffer_tx[5] = {0}; /* One byte command, max 4 bytes data */

	const struct spi_buf tx_buf[] = {{
		.buf = buffer_tx,
		.len = ARRAY_SIZE(buffer_tx),
	}};
	const struct spi_buf_set tx = {
		.buffers = tx_buf,
		.count = ARRAY_SIZE(tx_buf),
	};

	buffer_tx[0] = AD4111_CMD_WRITE | reg_addr;

	if (reg_size > 4) {
		LOG_ERR("Invalid size, max data write size is 4");
		return -ENOMEM;
	}

	// TODO: Check whether this can be avoided by use of sets.
	/* Fill the data */
	for (uint8_t index = 0; index < reg_size; index++) {
		buffer_tx[1 + index] = buffer[index];
	}

	ret = spi_write_dt(&spi, &tx);
	if (ret != 0) {
		LOG_ERR("error writing register 0x%X (%d)", reg_addr, ret);
		return ret;
	}

	return ret;
}

int ad4111_reset(void) {
    uint8_t tx_buffer_init_buffer[] = {
        0xFF, 0xFF, 0xFF, 0xFF,
        0xFF, 0xFF, 0xFF, 0xFF,
        0xFF, 0xFF, 0xFF, 0xFF,
        0xFF, 0xFF, 0xFF, 0xFF
    };

    struct spi_buf tx_init_spi_buf		= {.buf = (void *)tx_buffer_init_buffer, .len = 16};
    struct spi_buf_set tx_init_spi_buf_set 	= {.buffers = &tx_init_spi_buf, .count = 1};

	int ret = spi_write_dt(&spi, &tx_init_spi_buf_set);
	if (ret != 0) {
		LOG_ERR("error resetting (%d)", ret);
		return ret;
	}
	k_msleep(100); // AD4111 seems to have some bootup
    return ret;
}

int ad4111_check_id(void) {
	uint8_t id[2];

	int ret = ad4111_read_reg(AD4111_ID_REG, id, 2);
	if (ret != 0) {
		LOG_ERR("error reading id (%d)", ret);
		return ret;
	}

	/* Check that this is the expected ID : 0x30DX, where x is don’t care */
	if ((((id[0] << 8) | id[1]) & 0xFFF0) != 0x30D0) {
		LOG_ERR("Read wrong ID register 0x%X 0x%X", id[0], id[1]);
		return -EIO;
	}

	return 0;
}

int ad4111_set_channel(ad4111_channel_t channel) { 

    uint16_t channel_reg = 0;
    channel_reg |= (channel.ch_en & 0x1)      << 15;
    channel_reg |= (channel.setup_sel & 0x7)  << 12;
    channel_reg |= (channel.input & 0x3FF);

    uint8_t tx_buffer[2] = {(channel_reg >> 8) & 0xFF, channel_reg & 0xFF};

	return ad4111_write_reg(channel.reg, tx_buffer, 2);
}

int ad4111_set_setupcon(ad4111_setupcon_t setupcon) {
    uint16_t setupcon_reg = 0;

    setupcon_reg |= ((setupcon.bi_unipolar & 0x1)  << 12);
    setupcon_reg |= ((setupcon.refbuf_plus  & 0x1) << 11);
    setupcon_reg |= ((setupcon.refbuf_minus & 0x1) << 10);
    setupcon_reg |= ((setupcon.inbuf        & 0x3) << 8);
    setupcon_reg |= ((setupcon.ref_sel      & 0x3) << 4);

    uint8_t tx_buffer[2] = {(setupcon_reg >> 8) & 0xFF, setupcon_reg & 0xFF};

	return ad4111_write_reg(setupcon.reg, tx_buffer, 2);
}

int ad4111_set_filter(ad4111_filter_t filter) {

    uint16_t filter_reg = 0;

    filter_reg |= ((filter.enhfilten & 0x1) << 11);
    filter_reg |= ((filter.enhfilt   & 0x7) << 8);
  
    filter_reg |= ((filter.order     & 0x3) << 5);
    filter_reg |= ((filter.odr       & 0x1F) << 0);

    uint8_t tx_buffer[2] = {(filter_reg >> 8) & 0xFF, filter_reg & 0xFF};

	return ad4111_write_reg(filter.reg, tx_buffer, 2);
}

/*
 * totally hard coded adc mode.
 * REF_EN = 1, everything else = 0
 */
int ad4111_set_adcmode(void) { 
	uint16_t adcmode_reg = BIT(AD4111_ADCMODE_REF_EN);
	uint8_t tx_buffer[2] = {(adcmode_reg >> 8) & 0xFF, adcmode_reg & 0xFF};
	return ad4111_write_reg(AD4111_MODE_REG, tx_buffer, 2);
}
/*
 * totally hard coded if mode.
 * DATA_STAT = 1, everything else = 0
 */
int ad4111_set_ifmode(void) { 
	uint16_t ifmode_reg = BIT(AD4111_IFMODE_DATA_STAT);
	uint8_t tx_buffer[2] = {(ifmode_reg >> 8) & 0xFF, ifmode_reg & 0xFF};

	return ad4111_write_reg(AD4111_IFMODE_REG, tx_buffer, 2);
}

int initialize_interrupt() {
	int ret;

	if (!gpio_is_ready_dt(&miso_spec)) {
		LOG_ERR("Error: button device %s is not ready\n",
		       miso_spec.port->name);
		return -1;
	}

	ret = gpio_pin_configure_dt(&miso_spec, GPIO_INPUT);
	if (ret != 0) {
		printk("Error %d: failed to configure %s pin %d\n",
		       ret, miso_spec.port->name, miso_spec.pin);
		return ret;
	}

	// ret = gpio_pin_configure_dt(&miso_spec, GPIO_INPUT);
	ret = gpio_pin_interrupt_configure_dt(&miso_spec, GPIO_INT_EDGE_TO_INACTIVE);
	if (ret != 0) {
		printk("Error %d: failed to configure interrupt on %s pin %d\n",
			ret, miso_spec.port->name, miso_spec.pin);
		return ret;
	}
	gpio_init_callback(&miso_cb_data, miso_interrupt_handler, BIT(miso_spec.pin));
	gpio_add_callback(miso_spec.port, &miso_cb_data);
	return 0;
}

int initialize_gpio_miso() {
	int ret;
	if (!gpio_is_ready_dt(&miso_spec)) {
		LOG_ERR("Error: button device %s is not ready\n",
		       miso_spec.port->name);
		return -1;
	}

	ret = gpio_pin_configure_dt(&miso_spec, GPIO_INPUT);
	if (ret != 0) {
		printk("Error %d: failed to configure %s pin %d\n",
		       ret, miso_spec.port->name, miso_spec.pin);
		return ret;
	}
	return 0;
}

void ad4111_thread_fn(void) {
    int ret;

	ad4111_status = 0;
    while (true) {
		// int not_ready = gpio_pin_get_dt(&miso_spec);
		// if(!not_ready) {
		// if(spi_adc_int_count > 0) {
		if (k_sem_take(&adc_data_ready, K_MSEC(50)) != 0) {
			ad4111_status = 0;
			continue;
		}

		ad4111_status = 1;

		// Disable interrupt while reading data.
		ret = gpio_pin_interrupt_configure_dt(&miso_spec, GPIO_INT_DISABLE);
		if (ret != 0) break;

		uint8_t data[4];
		ret = ad4111_read_reg(AD4111_DATA_REG, data, 4);
		if (ret != 0) break;

		ret = gpio_pin_interrupt_configure_dt(&miso_spec, GPIO_INT_EDGE_TO_INACTIVE);
		if (ret != 0) break;

		struct adc_result conversion = {
			.data[0] = data[0],
			.data[1] = data[1],
			.data[2] = data[2],
			.status = data[3]
		};

		ret = conversion.status & 0xF0;
		if (ret != 0) {
			ad4111_status = 0;
			continue;
		}

		ret = k_msgq_put(&adc_results, &conversion, K_NO_WAIT);
		if (ret < 0) {
			ad4111_status = 0;
			continue;
		}
    }
	ad4111_status = 0;
}

int ad4111_get_data_blocking(uint32_t *code) {
	struct adc_result conversion;
	int ret = k_msgq_get(&adc_results, &conversion, K_MSEC(500));
	if (ret < 0) {
		return ret;
	}
	uint8_t *data = conversion.data;
	*code = ((int32_t)data[0] << 16) | ((int32_t)data[1] << 8) | data[2];
	assert((conversion.status & 0xF0) == 0);
	return conversion.status; 
}

int ad4111_get_status(void) {
	return ad4111_status;
}

K_THREAD_DEFINE(ad4111_thread,
                1024,
                ad4111_thread_fn,
                NULL, NULL, NULL,
                5,
                0,
                -1); // do not start

int ad4111_init(void) {
	int ret;

    if (!spi_is_ready_dt(&spi)) {
        LOG_ERR("Error: SPI device is not ready");
        return -1;
    }

	ret = ad4111_reset();
    if (ret != 0) return ret;

	ret = ad4111_check_id();
	if(ret != 0) return ret;

	uint8_t status;
	ad4111_read_reg(AD4111_STATUS_REG, &status, 1);
	LOG_INF("Found AD4111 with status %d", status);

	// Configuration for Sigurd
	// TODO: One day, someone could look into making this configurable
	//       via devicetree. Today, we are not the ones to do it.
	//       -> yeah, me neither. Good luck to the next person!

	ret = ad4111_set_adcmode();
	if(ret != 0) return ret;

	ret = ad4111_set_ifmode();
	if(ret != 0) return ret;


	// setup/filter/data rate for all thermocouples
	ad4111_setupcon_t thermocouple_setupcon;
	thermocouple_setupcon.reg = AD4111_SETUPCON0_REG;
	thermocouple_setupcon.bi_unipolar = UNIPOLAR;
	thermocouple_setupcon.refbuf_plus = 1;
	thermocouple_setupcon.refbuf_minus = 1;
	thermocouple_setupcon.inbuf = AD4111_INBUF_DISABLED;
	thermocouple_setupcon.ref_sel = INTERNAL_REF;
	ret = ad4111_set_setupcon(thermocouple_setupcon);
	if(ret != 0) return ret;

	ad4111_filter_t thermocouple_filter;
	thermocouple_filter.reg = AD4111_FILTCON0_REG;
	thermocouple_filter.enhfilten = AD4111_ENHFILT_DISABLED;
	thermocouple_filter.enhfilt = AD4111_ENHFILT_27SPS_47DB;
	thermocouple_filter.order = AD4111_FILTER_SINC5_SINC1;
	thermocouple_filter.odr = AD4111_ODR_200_SPS;
	ret = ad4111_set_filter(thermocouple_filter);
	if(ret != 0) return ret;

	// thermocouple channels: 0..3
	ad4111_channel_t thermocouple;
	thermocouple.reg = AD4111_CHANNEL_0_REG;
	thermocouple.ch_en = 1;
	thermocouple.setup_sel = 0;
	thermocouple.input = VIN7_VINCOM;
	ret = ad4111_set_channel(thermocouple);
	if(ret != 0) return ret;

	thermocouple.reg = AD4111_CHANNEL_1_REG;
	thermocouple.input = VIN6_VINCOM;
	ret = ad4111_set_channel(thermocouple);
	if(ret != 0) return ret;

	thermocouple.reg = AD4111_CHANNEL_2_REG;
	thermocouple.input = VIN5_VINCOM;
	ret = ad4111_set_channel(thermocouple);
	if(ret != 0) return ret;

	thermocouple.reg = AD4111_CHANNEL_3_REG;
	thermocouple.input = VIN4_VINCOM;
	ret = ad4111_set_channel(thermocouple);
	if(ret != 0) return ret;


	// setup/filter/data rate for all pressure gauges
	ad4111_setupcon_t pressure_gauge_setupcon;
	pressure_gauge_setupcon.reg = AD4111_SETUPCON1_REG;
	pressure_gauge_setupcon.bi_unipolar = BIPOLAR;
	pressure_gauge_setupcon.refbuf_plus = 0;
	pressure_gauge_setupcon.refbuf_minus = 0;
	pressure_gauge_setupcon.inbuf = AD4111_INBUF_DISABLED;
	pressure_gauge_setupcon.ref_sel = INTERNAL_REF;
	ret = ad4111_set_setupcon(pressure_gauge_setupcon);
	if(ret != 0) return ret;

	ad4111_filter_t pressure_gauge_filter;
	pressure_gauge_filter.reg = AD4111_FILTCON1_REG;
	pressure_gauge_filter.enhfilten = AD4111_ENHFILT_DISABLED;
	pressure_gauge_filter.enhfilt = AD4111_ENHFILT_27SPS_47DB;
	pressure_gauge_filter.order = AD4111_FILTER_SINC5_SINC1;
	pressure_gauge_filter.odr = AD4111_ODR_200_SPS;
	ret = ad4111_set_filter(pressure_gauge_filter);
	if(ret != 0) return ret;

	// pressure gauge channels: 4..7
	ad4111_channel_t pressure_gauge;
	pressure_gauge.reg = AD4111_CHANNEL_4_REG;
	pressure_gauge.ch_en = 1;
	pressure_gauge.setup_sel = 1;
	pressure_gauge.input = IIN3P_IIN3M;
	ret = ad4111_set_channel(pressure_gauge);
	if(ret != 0) return ret;

	pressure_gauge.reg = AD4111_CHANNEL_5_REG;
	pressure_gauge.input = IIN2P_IIN2M;
	ret = ad4111_set_channel(pressure_gauge);
	if(ret != 0) return ret;

	pressure_gauge.reg = AD4111_CHANNEL_6_REG;
	pressure_gauge.input = IIN1P_IIN1M;
	ret = ad4111_set_channel(pressure_gauge);
	if(ret != 0) return ret;

	pressure_gauge.reg = AD4111_CHANNEL_7_REG;
	pressure_gauge.input = IIN0P_IIN0M;
	ret = ad4111_set_channel(pressure_gauge);
	if(ret != 0) return ret;


	// setup/filter/data rate for all RTDs
	ad4111_setupcon_t RTD_setupcon;
	RTD_setupcon.reg = AD4111_SETUPCON2_REG;
	RTD_setupcon.bi_unipolar = BIPOLAR;
	RTD_setupcon.refbuf_plus = 1;
	RTD_setupcon.refbuf_minus = 1;
	RTD_setupcon.inbuf = AD4111_INBUF_ENABLED;
	RTD_setupcon.ref_sel = INTERNAL_REF;
	ret = ad4111_set_setupcon(RTD_setupcon);
	if(ret != 0) return ret;

	ad4111_filter_t RTD_filter;
	RTD_filter.reg = AD4111_FILTCON2_REG;
	RTD_filter.enhfilten = AD4111_ENHFILT_DISABLED;
	RTD_filter.enhfilt = AD4111_ENHFILT_27SPS_47DB;
	RTD_filter.order = AD4111_FILTER_SINC5_SINC1;
	RTD_filter.odr = AD4111_ODR_200_SPS;
	ret = ad4111_set_filter(RTD_filter);
	if(ret != 0) return ret;

	// RTD channels: 8..9
	ad4111_channel_t RTD;
	RTD.reg = AD4111_CHANNEL_8_REG;
	RTD.ch_en = 1;
	RTD.setup_sel = 2;
	RTD.input = VIN0_VIN1;
	ret = ad4111_set_channel(RTD);
	if(ret != 0) return ret;

	RTD.reg = AD4111_CHANNEL_9_REG;
	RTD.input = VIN2_VIN3;
	ret = ad4111_set_channel(RTD);
	if(ret != 0) return ret;


    k_thread_start(ad4111_thread);

	// ret = initialize_gpio_miso();
	ret = initialize_interrupt();
	if(ret != 0) return ret;

	return 0;
}
```

## src/ad4111.h
```c
#ifndef AD4111_H
#define AD4111_H

#include <stdint.h>

int ad4111_init(void);

/*
 * Reports the status of the AD4111 driver.
 * @returns 1 If things are working good :)
 *          0 If things are working bad  :(
 */
int ad4111_get_status(void);

/*
 * Get the next conversion produced by the AD4111. 
 * @param code pointer to a value that should contain the next conversion.
 * @returns >=0: channel
 *          <0 : something has gone wrong.
*/
int ad4111_get_data_blocking(uint32_t *code);

static inline float data_to_volts_unipolar(int32_t data) {
	float code = data;
	float vref = 2.5;
	float two_to_the_power_24 = 2 << (24 - 1);
	float volts = (code * vref) / (0.1f * two_to_the_power_24);
	return volts;
}

// static inline float data_to_volts_bipolar(int32_t data) {
// 	float code = data;
// 	float vref = 2.5;
// 	float two_to_the_power_23 = 2 << (23 - 1);
// 	float volts = (code/two_to_the_power_23-1) * vref/0.1f;
// 	return volts;
// }

static inline float data_to_amps_bipolar(int32_t data) {
	float code = data;
	float vref = 2.5;
	float two_to_the_power_23 = 2 << (23 - 1);
	float amps = (code/two_to_the_power_23-1) * vref/50;
	return amps;
}

static inline float data_to_volts_bipolar(int32_t data) {
	float code = data;
	float vref = 2.5;
	float two_to_the_power_23 = 2 << (23 - 1);
	// float volts = (code/two_to_the_power_23-1) * vref/0.1f;
	float volts = 10*(1 - code/two_to_the_power_23)*vref;
	// (1 - codeneg24/2**23)*vref
	return volts;
}

#endif
```

## src/can_com.c
```c
#include <zephyr/drivers/can.h>
#include <zephyr/kernel.h>
#include <zephyr/logging/log.h>
#include <zephyr/sys/util.h>
#include <errno.h>

LOG_MODULE_REGISTER(can_com);

K_MSGQ_DEFINE(can_tx_queue,
              sizeof(struct can_frame),
              8,            /* queue length (frames) */
              1);            /* alignment */
K_SEM_DEFINE(can_tx_done, 1, 1);

#define FDCAN_1_NODE DT_ALIAS(fdcan1)

const struct device *const can_dev = DEVICE_DT_GET(FDCAN_1_NODE);


void can_tx_cb(const struct device *device, int error, void *user_data) {
    k_sem_give(&can_tx_done);
    if (error) {
        LOG_ERR("can send callback error %d", error);
    }
}

int submit_can_pkt(uint16_t id, const void *packet, size_t length) {
    struct can_frame frame = {
            .flags = 0,
            .id = id,
            .dlc = length,
    };
    memcpy(frame.data, packet, length);
    int ret = k_msgq_put(&can_tx_queue, &frame, K_NO_WAIT);
    if (ret == -EAGAIN) {
        LOG_ERR("can tx queue full");
    }
    return 0;
}

void can_thread_fn(void) {
    int ret;
    struct can_frame frame;

    while (1) {
        ret = k_msgq_get(&can_tx_queue, &frame, K_FOREVER);
        if (ret) {
            LOG_INF("k_msgq_get returned error %d", ret);
        }

        // wait until previous frame is sent
        k_sem_take(&can_tx_done, K_MSEC(200));

        LOG_INF("sending can message 0x%02X", frame.id);

        // send frame (blocking until mailbox is available)
        ret = can_send(can_dev, &frame,
                           K_MSEC(100),
                            can_tx_cb,
                           NULL);

        if (ret ) { // callback not called
            LOG_ERR("can send error %d", ret);
            k_sem_give(&can_tx_done);
        }
    }
}

K_THREAD_DEFINE(can_thread,
                1024,
                can_thread_fn,
                NULL, NULL, NULL,
                1, // priority
                0,
                -1); // do not start


int add_filter_can(can_rx_callback_t rx_callback, struct can_filter filter, void *can_user_data) {
    int ret = can_add_rx_filter(can_dev, rx_callback, can_user_data, &filter);
    if (ret < 0) {
        LOG_ERR("adding can filter failed: %d", ret);
    } else {
        LOG_INF("adding can filter success");
    }
    return ret;
}

int init_can() {
    int ret;

 
    if (!device_is_ready(can_dev)) {
        LOG_ERR("CAN device not ready");
        return -1;
    }

    ret = can_set_bitrate(can_dev, 500000); // 500 kb/s
    if (ret) {
        LOG_ERR("failed to set CAN nominal bitrate: [%d]", ret);
        return -1;
    } else {
        LOG_INF("CAN nominal bitrate successfully set to 500kb/s");
    }

    ret = can_set_bitrate_data(can_dev, 500000); // 500 kb/s
    if (ret) {
        LOG_ERR("failed to set CAN bitrate: [%d]", ret);
        return -1;
    } else {
        LOG_INF("CAN bitrate successfully set to 500kb/s");
    }

    ret = can_start(can_dev);
    if (ret) {
        LOG_ERR("failed to start CAN: %d", ret);
        return -1;
    } else{
        LOG_INF("CAN started");
    }

    k_thread_start(can_thread);

    return 0;
}
```

## src/can_com.h
```c
#ifndef __CAN_COM_H
#define __CAN_COM_H

#ifdef __cplusplus
extern "C" {
#endif

#include <stddef.h>
#include <zephyr/drivers/can.h>

int init_can();

int submit_can_pkt(uint16_t id, const void *packet, size_t length);

int add_filter_can(can_rx_callback_t rx_callback, struct can_filter filter, void *can_user_data);


#ifdef __cplusplus
}
#endif

#endif /* __CAN_COM_H */
```

## src/main.h
```c
#ifndef __MAIN_H
#define __MAIN_H


#ifdef __cplusplus
extern "C" {

int initializePins(void);






#endif

#ifdef __cplusplus
}
#endif

#endif /* __MAIN_H */
```

## src/sensors.c
```c
#include <zephyr/kernel.h>
#include <zephyr/logging/log.h>

#include "ad4111.h"
#include "sensors.h"

LOG_MODULE_REGISTER(sensors, LOG_LEVEL_INF);

struct running_average {
	int n;
	float sum;
};

void add_new_data(struct running_average *average, float x) {
    average->sum += x;
    average->n++;
}

K_MUTEX_DEFINE(sensor_data_mutex);
static struct running_average thermocouples[4] = {0};
static struct running_average pressure_gauges[4] = {0};
static struct running_average rtds[2] = {0};

static int sensors_working = 0;

int sensors_get_status(void) {
    return sensors_working; // TODO: technically a race condition
}


void sensor_thread_fn(void) {
	while(true) {
        sensors_working = 1;
		// extracting the channel number for this reading
			
		int32_t data_reg;
		int channel = ad4111_get_data_blocking(&data_reg);
		if(channel < 0) {
            sensors_working = 0;
            continue; //TODO: Investigate how often this path is taken.
        }

        if (k_mutex_lock(&sensor_data_mutex, K_MSEC(500))) {
            sensors_working = 0;
            continue;
        }
		switch(channel) {
			case 0: // thermocouple0-3
				add_new_data(&thermocouples[0], data_to_volts_unipolar(data_reg));
                break;
			case 1:
				add_new_data(&thermocouples[1], data_to_volts_unipolar(data_reg));
                break;
			case 2:
				add_new_data(&thermocouples[2], data_to_volts_unipolar(data_reg));
                break;
			case 3:
				add_new_data(&thermocouples[3], data_to_volts_unipolar(data_reg));
				break;
			case 4: // pressure_gauge0-3
				add_new_data(&pressure_gauges[0], data_to_amps_bipolar(data_reg));
				break;
			case 5:
				add_new_data(&pressure_gauges[1], data_to_amps_bipolar(data_reg));
				break;
			case 6:
				add_new_data(&pressure_gauges[2], data_to_amps_bipolar(data_reg));
				break;
			case 7:
				add_new_data(&pressure_gauges[3], data_to_amps_bipolar(data_reg));
				break;
			case 8: // RTD0-1
				add_new_data(&rtds[0], data_to_volts_bipolar(data_reg));
				break;
			case 9:
				add_new_data(&rtds[1], data_to_volts_bipolar(data_reg));
				break;
			default:
                sensors_working = 0;
				continue;
				break;
        }
        k_mutex_unlock(&sensor_data_mutex);
	}
}

K_THREAD_DEFINE(sensors_thread, 4096, sensor_thread_fn, NULL, NULL, NULL, 5, 0, 0);

int init_sensors(void) {
	int ret = ad4111_init();
	if (ret < 0) {
		return ret;
	}


    k_thread_start(sensors_thread);

    return 0;
}

int get_averages(float *averages, struct running_average *running_averages, int n) {
    if (k_mutex_lock(&sensor_data_mutex, K_MSEC(3000))) {
        // Failed to acquire mutex
        return -BIT(5);
    }
    for (int i = 0; i < n; i++) {
        averages[i] = running_averages[i].sum/running_averages[i].n;
        running_averages[i].sum = 0;
        running_averages[i].n = 0;
    }
    k_mutex_unlock(&sensor_data_mutex);
    return 0;
}

int thermocouple_get_voltages(float *voltages) {
    return get_averages(voltages, thermocouples, 4);
}

int pressure_gauges_get_currents(float *currents) {
    return get_averages(currents, pressure_gauges, 4);
}

int rtds_get_voltages(float *voltages) {
    return get_averages(voltages, rtds, 2);
}
```

## src/sensors.h
```c
#ifndef __SENSORS_H
#define __SENSORS_H

int init_sensors(void);
int sensors_get_status(void);
/*
 * Get the running average voltage of the four thermocouples and clear the running average buffer.
 * Note: This is a blocking function!
 * @param averages A pointer to an array of four floats where the data will be written.
 * @returns error_code 0  => it all worked
 *                     <0 => there was a thermocouple with no conversions
 *          -error_code = bxxx0 means thermocouple 1 had an error
 *          -error_code = bxx0x means thermocouple 2 had an error
 *                        etc....
 */
int thermocouple_get_voltages(float *voltages);
/*
 * Same as thermocouple_get_voltages but for pressure gauges
 */
int pressure_gauges_get_currents(float *currents);
/*
 * Same as thermocouple_get_voltages but for rtds
 */
int rtds_get_voltages(float *voltages);


#endif /* __SENSORS_H */
```

## src/sensorsbackup.c
```c
#include <zephyr/kernel.h>
#include <zephyr/logging/log.h>
#include <zephyr/drivers/adc.h>

#include <ad4111.h>
#include "sensors.h"

LOG_MODULE_REGISTER(sensors, LOG_LEVEL_INF);


//CAN thread
//sensor thread


double ad4111_current_to_pressure(int32_t val) {
    double pressure = val * 2.5 / ((1 << 24) * 0.1);

    return pressure;
}

double pressures[NUM_PRESSURE_TRANSDUCERS];
int32_t pressure_adc_vals[NUM_PRESSURE_TRANSDUCERS];

double get_pressure(size_t index) {
    return pressures[index];
}

int32_t get_pressure_adc(size_t index) {
    return pressure_adc_vals[index];
}

void sensor_thread_fn(void) {

    const struct device* ext_adc1 = DEVICE_DT_GET(DT_ALIAS(xadc1));

    if (!device_is_ready(ext_adc1)) {
        LOG_ERR("ext_adc1 not ready");
        return;
    }

    LOG_INF("ext_adc1 ready");

    //struct

    // temperature sensor 1
    // temp sensor ...
    // pressure sensor ... 

    while (1) {

        // for (int i = 0; i < 10; i++) {
        //     int32_t adc_value;
        //     ad4111_read_channel(ext_adc1, i, &adc_value);

        //     pressures[i] = ad4111_current_to_pressure(adc_value);

        //     k_sleep(K_MSEC(10));

        // }

        // for (int i = 8; i <= 11; i++) {
            int32_t adc_value;
            ad4111_read_channel(ext_adc1, 8, &adc_value);

            pressure_adc_vals[0] = adc_value;
            // pressure_adc_vals[i-6] = 0xAABBCCDD;
            // pressures[i-6] = ad4111_current_to_pressure(adc_value);

            k_sleep(K_MSEC(10));
        // }
        k_sleep(K_MSEC(1000));

    }
}

K_THREAD_DEFINE(sensors_thread, 4096, sensor_thread_fn, NULL, NULL, NULL, 5, 0, 0);

void init_sensors(void) {
    k_thread_start(sensors_thread);

}
```

## src/spi.c
```c
#include <zephyr/drivers/spi.h>

#define COMMS_REG 0x00
#define ID_REG 0x07

//CONFIG_SPI=y

//https://academy.nordicsemi.com/courses/nrf-connect-sdk-intermediate/lessons/lesson-5-serial-peripheral-interface-spi/topic/zephyr-spi-api/

#define SPIOP      SPI_WORD_SET(8) | SPI_TRANSFER_MSB | SPI_MODE_CPOL | SPI_MODE_CPHA

//fix
struct spi_dt_spec spi = SPI_DT_SPEC_GET(DT_NODELABEL(ext_adc1), SPIOP, 0)

ret = spi_is_ready_dt(&spi);
if (ret != 0) {
	LOG_ERR("Error: SPI device is not ready, err: %d", err);
	return 0;
}

uint8_t tx_buffer = 0x88;

uint16_t data;
struct spi_buf tx_spi_buf		= {.buf = (void *)&tx_buffer, .len = 1};
struct spi_buf_set tx_spi_buf_set 	= {.buffers = &tx_spi_buf, .count = 1};

struct spi_buf rx_spi_bufs 		= {.buf = data, .len = 2};
struct spi_buf_set rx_spi_buf_set	= {.buffers = &rx_spi_bufs, .count = 1};

ret = spi_transceive_dt(&spi, &tx_spi_buf_set, &rx_spi_buf_set);

if (ret!=0) { 
    LOG_ERR("ERROR: SPI DEVICE sucks")
    return 0
}


	
```

## src/spitest.c
```c
#include <zephyr/drivers/spi.h>
#include <zephyr/logging/log.h>
#include <zephyr/drivers/pinctrl.h>

LOG_MODULE_REGISTER(spitest, LOG_LEVEL_DBG);

#include "ad4111.h"

#define SPIOP SPI_WORD_SET(8) | SPI_TRANSFER_MSB | SPI_MODE_CPOL | SPI_MODE_CPHA 

struct spi_dt_spec spi = SPI_DT_SPEC_GET(DT_NODELABEL(ext_adc1), SPIOP);

void runsetupspi() {
    // pinctrl_apply_state(pcfg, PINCTRL_STATE_DEFAULT);
    uint8_t tx_buffer_init_buffer[] = {
        0xFF, 0xFF, 0xFF, 0xFF,
        0xFF, 0xFF, 0xFF, 0xFF,
        0xFF, 0xFF, 0xFF, 0xFF,
        0xFF, 0xFF, 0xFF, 0xFF
    };
    struct spi_buf tx_init_spi_buf		= {.buf = (void *)tx_buffer_init_buffer, .len = 16};
    struct spi_buf_set tx_init_spi_buf_set 	= {.buffers = &tx_init_spi_buf, .count = 1};
    spi_write_dt(&spi, &tx_init_spi_buf_set);
}

/**
 * @param rx_buffer Needs to be length 4.
 */
int runspitest(uint8_t *rx_buffer) {

    int ret = spi_is_ready_dt(&spi);
    if (ret == 0) {
        LOG_ERR("Error: SPI device is not ready, err: %d", ret);
        return 0;
    }

    // uint8_t tx_buffer[3] = {0b01000111, 0, 0}; // read from ID register
    uint8_t tx_buffer[] = {0x44, 0, 0, 0}; // read from data register
    // loop
    // transcieve, timing between sending and recieving.
    // soft reset

    struct spi_buf tx_spi_buf		= {.buf = (void *)tx_buffer, .len = 4};
    struct spi_buf_set tx_spi_buf_set 	= {.buffers = &tx_spi_buf, .count = 1};

    // uint8_t data[] = {0xFF, 0xFF, 0xFF, 0xFF};
    struct spi_buf rx_spi_buf 		= {.buf = (void *)rx_buffer, .len = 4};
    struct spi_buf_set rx_spi_buf_set	= {.buffers = &rx_spi_buf, .count = 1};

    ret = spi_transceive_dt(&spi, &tx_spi_buf_set, &rx_spi_buf_set);

    if (ret!=0) { 
        LOG_ERR("ERROR: SPI DEVICE sucks");
        return 1;
    }
    return 0;

    // ret = spi_read_dt(&spi, &rx_spi_buf_set);
    // if (ret!=0) { 
    //     LOG_ERR("ERROR: SPI DEVICE sucks");
    //     return 0;
    // }

    // LOG_INF("%d", data);

    // return data[2];

}

void AD4111_Reset() { 
    
    uint8_t tx_buffer_init_buffer[] = {
        0xFF, 0xFF, 0xFF, 0xFF,
        0xFF, 0xFF, 0xFF, 0xFF,
        0xFF, 0xFF, 0xFF, 0xFF,
        0xFF, 0xFF, 0xFF, 0xFF
    };
    struct spi_buf tx_init_spi_buf		    = {.buf = (void *)tx_buffer_init_buffer, .len = 16};
    struct spi_buf_set tx_init_spi_buf_set 	= {.buffers = &tx_init_spi_buf, .count = 1};
    spi_write_dt(&spi, &tx_init_spi_buf_set);
}

int AD4111_ID() { 
    //send the 0x47, to read from the ID register

    int ret = spi_is_ready_dt(&spi);
    if (ret == 0) {
        LOG_ERR("Error: SPI device is not ready, err: %d", ret);
        return 0;
    }

    uint8_t tx_buffer[3] = {0b01000111, 0, 0}; // read from ID register


    struct spi_buf tx_spi_buf		    = {.buf = (void *)tx_buffer, .len = 3};
    struct spi_buf_set tx_spi_buf_set 	= {.buffers = &tx_spi_buf, .count = 1};

    uint8_t data[] = {0xFF, 0xFF, 0xFF};
    struct spi_buf rx_spi_buf 		    = {.buf = (void *)data, .len = 3};
    struct spi_buf_set rx_spi_buf_set	= {.buffers = &rx_spi_buf, .count = 1};

    ret = spi_transceive_dt(&spi, &tx_spi_buf_set, &rx_spi_buf_set);

    if (ret!=0) { 
        LOG_ERR("ERROR: SPI DEVICE sucks");
        return 0;
    }

    return data[2];
}



void ad4111_channel(ad4111_channel_t* channel) { 


    uint8_t comms = channel->ch_id & 0x3F;

    uint16_t chan_reg = 0;

    chan_reg |= (channel->ch_en & 0x1)      << 15;
    chan_reg |= (channel->setup_sel & 0x7)  << 12;
    chan_reg |= (channel->input & 0x3FF);

    uint8_t tx_buffer[3] = {comms, (chan_reg >> 8) & 0xFF, chan_reg & 0xFF}; // read from ID register


    struct spi_buf tx_spi_buf		    = {.buf = (void *)tx_buffer, .len = 3};
    struct spi_buf_set tx_spi_buf_set 	= {.buffers = &tx_spi_buf, .count = 1};


    //dummy data, not actually necessary, one could use spi_write_dt, but i hate zephyr
    uint8_t rx_dummy[] = {0xFF, 0xFF, 0xFF};
    struct spi_buf rx_spi_buf 		    = {.buf = (void *)rx_dummy, .len = 3};
    struct spi_buf_set rx_spi_buf_set	= {.buffers = &rx_spi_buf, .count = 1};

    spi_transceive_dt(&spi, &tx_spi_buf_set, &rx_spi_buf_set);

}

void ad4111_config_channel(ad4111_setup_t *setup)
{

    uint8_t comms = setup->setup_id & 0x3F;

    uint16_t cfg_reg = 0;

    cfg_reg |= ((setup->bi_unipolar & 0x1)  << 12);
    cfg_reg |= ((setup->refbuf_plus  & 0x1) << 11);
    cfg_reg |= ((setup->refbuf_minus & 0x1) << 10);
    cfg_reg |= ((setup->inbuf        & 0x3) << 8);
    cfg_reg |= ((setup->ref_sel      & 0x3) << 4);

    uint8_t tx_buffer[3] = {comms, (cfg_reg >> 8) & 0xFF, cfg_reg & 0xFF};

    struct spi_buf tx_spi_buf = {.buf = (void *)tx_buffer, .len = 3};

    struct spi_buf_set tx_spi_buf_set = {.buffers = &tx_spi_buf, .count = 1};

    
    uint8_t rx_dummy[3];
    struct spi_buf rx_spi_buf = {.buf = rx_dummy, .len = 3};

    struct spi_buf_set rx_spi_buf_set = {.buffers = &rx_spi_buf, .count = 1};

    spi_transceive_dt(&spi, &tx_spi_buf_set, &rx_spi_buf_set);

}



void ad4111_config_filter(ad4111_filter_t *filter)
{

    uint8_t comms = filter->filter_id & 0x3F;

    uint16_t filter_reg = 0;

    filter_reg |= ((filter->enhfilten & 0x1) << 11);
    filter_reg |= ((filter->enhfilt   & 0x7) << 8);
  
    filter_reg |= ((filter->order     & 0x3) << 5);
    filter_reg |= ((filter->odr       & 0x1F) << 0);

    uint8_t tx_buffer[3] = {comms, (filter_reg >> 8) & 0xFF, filter_reg & 0xFF};

    struct spi_buf tx_spi_buf = {.buf = (void *)tx_buffer, .len = 3};

    struct spi_buf_set tx_spi_buf_set = {.buffers = &tx_spi_buf, .count = 1};

    uint8_t rx_dummy[3];
    struct spi_buf rx_spi_buf = {.buf = (void *)rx_dummy, .len = 3};

    struct spi_buf_set rx_spi_buf_set = {.buffers = &rx_spi_buf, .count = 1};

    spi_transceive_dt(&spi, &tx_spi_buf_set, &rx_spi_buf_set);

}




//also make sure to tie the thermocouple amplifiers to GND via a certain solder bridge on Sigurd
//please check schematic for more info

void ad4111_adc_mode(void) { 
    //this must be written as well!
    //check Table 26 on datasheet!

}
```

## src/spitest.h
```c
#ifndef __SPITEST_H
#define __SPITEST_H

#ifdef __cplusplus
extern "C" {
#endif


int runspitest(uint8_t *rx_buffer);
void runsetupspi();




#ifdef __cplusplus
}
#endif

#endif /* __SPITEST_H */
```
